## drivers/sensor/st/iis3dwb10is/Kconfig
```kconfig
# ST Microelectronics IIS3DWB10IS accelerometer sensor

# Copyright (c) 2025 STMicroelectronics
# SPDX-License-Identifier: Apache-2.0

menuconfig IIS3DWB10IS
	bool "IIS3DWB10IS accelerometer sensor"
	default y
	depends on DT_HAS_ST_IIS3DWB10IS_ENABLED
	depends on ZEPHYR_HAL_ST_MODULE
	select SPI
	select HAS_STMEMSC
	select USE_STDC_IIS3DWB10IS
	help
	  Enable driver for IIS3DWB10IS SPI-based accelerometer sensor.

if IIS3DWB10IS

config IIS3DWB10IS_STREAM
	bool "IIS3DWB10IS data streaming"
	select IIS3DWB10IS_TRIGGER
	default y
	depends on SPI_RTIO
	depends on SENSOR_ASYNC_API
	help
	  Use this config option to enable streaming sensor data via RTIO subsystem.

config IIS3DWB10IS_TRIGGER
	bool

config IIS3DWB10IS_ENABLE_TEMP
	bool "Temperature"
	help
	  Enable/disable temperature sensor

endif # IIS3DWB10IS
```

## dts/bindings/sensor/st,lps27dewo-common.yaml
```yaml
# Copyright (c) 2025 STMicroelectronics
# SPDX-License-Identifier: Apache-2.0

description: |
    When setting the odr, lpf, avg properties in a .dts or .dtsi file
    you may include lps2xdf.h and use the macros defined there.

    Example:
    #include <zephyr/dt-bindings/sensor/lps2xdf.h>

    lps22df@5d {
      ...

      fs = <LPS27DEWO_DT_FS_MODE_2_6060>;
    };

include: st,lps22df-common.yaml

properties:
  fs:
    type: int
    default: 0
    description: |
        Specify the full-scale mode.
        The default is the power-on reset value.

        - 0 # LPS27DEWO_DT_FS_MODE_1_1260
        - 1 # LPS27DEWO_DT_FS_MODE_2_6060
    enum: [0, 1]
```

## dts/bindings/sensor/st,lps27dewo-i2c.yaml
```yaml
# Copyright (c) 2025 STMicroelectronics
# SPDX-License-Identifier: Apache-2.0

description: |
    STMicroelectronics LPS27DEWO pressure and temperature sensor connected to I2C
    bus

compatible: "st,lps27dewo"

include: ["i2c-device.yaml", "st,lps27dewo-common.yaml"]
```

## dts/bindings/sensor/st,lps27dewo-i3c.yaml
```yaml
# Copyright (c) 2025 STMicroelectronics
# SPDX-License-Identifier: Apache-2.0

description: |
    STMicroelectronics LPS27DEWO pressure and temperature sensor connected to I3C
    bus

compatible: "st,lps27dewo"

include: ["i3c-device.yaml", "st,lps27dewo-common.yaml"]
```

## dts/bindings/sensor/st,lps27dewo-spi.yaml
```yaml
# Copyright (c) 2025 STMicroelectronics
# SPDX-License-Identifier: Apache-2.0

description: |
    STMicroelectronics LPS27DEWO pressure and temperature sensor connected to SPI
    bus

compatible: "st,lps27dewo"

include: ["spi-device.yaml", "st,lps27dewo-common.yaml"]
```

## dts/bindings/sensor/st,lsm6dsv16x-common.yaml
```yaml
# Copyright (c) 2023 STMicroelectronics
# SPDX-License-Identifier: Apache-2.0

description: |
    When setting the accel-range, accel-odr, gyro-range, gyro-odr properties in
    a .dts or .dtsi file you may include lsm6dsv16x.h and use the macros
    defined there.

include: st,lsm6dsvxxx-common.yaml

properties:
  accel-range:
    type: int
    default: 2
    description: |
      Range in g. Default is power-up configuration.

      - 2  # LSM6DSV16X_DT_FS_2G  (0.061 mg/LSB)
      - 4  # LSM6DSV16X_DT_FS_4G  (0.122 mg/LSB)
      - 8  # LSM6DSV16X_DT_FS_8G  (0.244 mg/LSB)
      - 16 # LSM6DSV16X_DT_FS_16G (0.488 mg/LSB)

    enum: [2, 4, 8, 16]

  gyro-range:
    type: int
    default: 0
    description: |
      Range in dps. Default is power-up configuration.

      - 0x0 # LSM6DSV16X_DT_FS_125DPS  (4.375 mdps/LSB)
      - 0x1 # LSM6DSV16X_DT_FS_250DPS  (8.75 mdps/LSB)
      - 0x2 # LSM6DSV16X_DT_FS_500DPS  (17.50 mdps/LSB)
      - 0x3 # LSM6DSV16X_DT_FS_1000DPS (35 mdps/LSB)
      - 0x4 # LSM6DSV16X_DT_FS_2000DPS (70 mdps/LSB)
      - 0xc # LSM6DSV16X_DT_FS_4000DPS (140 mdps/LSB)

    enum: [0x0, 0x1, 0x2, 0x3, 0x4, 0xc]

  stepcnt-enable:
    type: boolean
    description: |
      Enable step counter.

  stepcnt-fifo-enable:
    type: boolean
    description: |
      Enable step counter in FIFO mode.

  stepcnt-false-rej:
    type: boolean
    description: |
      Enable false step rejection feature for step counter in FIFO mode.

  stepcnt-debounce:
    type: int
    default: 0xa
    description: |
      Configure the pedometer debounce, i.e. the minimum number of steps to
      increment the step counter. Default is power-up configuration.
      Valid range: 0 - 255

  stepcnt-delta-time:
    type: int
    default: 0
    description: |
      Configure the delta time (with 6.4 ms resolution) for step detection, i.e. the
      time period to generate interrupt if at least one step is detected. A value of 0,
      which is the default as per power-up configuration, means to generate interrupt
      as a step is detected.
      Valid range: 0 - 65535

examples:
  - |
    #include <zephyr/dt-bindings/sensor/lsm6dsv16x.h>

    lsm6dsv16x: lsm6dsv16x@0 {
      /* ... */

      accel-range = <LSM6DSV16X_DT_FS_8G>;
      accel-odr = <LSM6DSVXXX_DT_ODR_AT_60Hz>;
      gyro-range = <LSM6DSV16X_DT_FS_4000DPS>;
      gyro-odr = <LSM6DSVXXX_DT_ODR_AT_60Hz>;
    };
```

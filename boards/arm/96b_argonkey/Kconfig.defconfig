## boards/arm/96b_argonkey/Kconfig.defconfig
```kconfig
# Kconfig - 96Boards Argonkey Board Configuration
#
# Copyright (c) 2018 STMicroelectronics
#
# SPDX-License-Identifier: Apache-2.0
#

if BOARD_96B_ARGONKEY

config BOARD
	default "96b_argonkey"

if UART_CONSOLE

config UART_STM32_PORT_1
	default y

endif # UART_CONSOLE

if I2C

config I2C_1
	default y

config I2C_2
	default y

config I2C_3
	default y

config I2C_STM32_INTERRUPT
	default y

endif # I2C

if SPI

config SPI_2
	default y

endif # SPI

if I2S

config I2S_STM32
	default y

# use PLLI2S with default PLLM/PLLN/PLLR values
config I2S_STM32_USE_PLLI2S_ENABLE
	default y

config I2S_5
	default y

endif # I2S

if DMA

config DMA_STM32F4X
	default y

endif # DMA

if LSM6DSL

choice LSM6DSL_BUS_TYPE
	default LSM6DSL_SPI
endchoice

choice LSM6DSL_TRIGGER_MODE
	default LSM6DSL_TRIGGER_GLOBAL_THREAD
endchoice

config LSM6DSL_SENSORHUB
	default y

choice LSM6DSL_EXTERNAL_SENSOR_0
	default LSM6DSL_EXT0_LIS2MDL
endchoice

endif # LSM6DSL

endif # BOARD_96B_ARGONKEY
```

## drivers/audio/Kconfig.st_dmic_i2s
```kconfig
#
# Copyright (c) 2018 STMicroelectronics
#
# SPDX-License-Identifier: Apache-2.0
#

menuconfig AUDIO_ST_DMIC_I2S
	bool "ST Digital PDM microphone attached to I2S support"
	depends on AUDIO_DMIC
	depends on I2S
	select HAS_STLIB
	help
	  Enable ST_DMIC_I2S microphone support on the selected board
```

## drivers/i2s/Kconfig
```kconfig
# Kconfig - I2S (Inter-IC Sound) driver configuration options
#
# Copyright (c) 2017 Piotr Mienkowski
# SPDX-License-Identifier: Apache-2.0
#

#
# I2S Drivers
#
menuconfig I2S
	bool
	prompt "I2S bus drivers"
	help
	  Enable support for the I2S (Inter-IC Sound) hardware bus.

if I2S

config I2S_INIT_PRIORITY
	int "Init priority"
	default 70
	help
	  Device driver initialization priority.

config SYS_LOG_I2S_LEVEL
	int "I2S Driver Log level"
	depends on SYS_LOG
	default 0
	range 0 4
	help
	  Sets log level for I2S drivers.
	  Levels are:
	  0 OFF, do not write
	  1 ERROR, only write SYS_LOG_ERR
	  2 WARNING, write SYS_LOG_WRN in addition to previous level
	  3 INFO, write SYS_LOG_INF in addition to previous levels
	  4 DEBUG, write SYS_LOG_DBG in addition to previous levels

config	I2S_1
	bool "I2S port 1"
	default n
	help
	  Enable I2S controller port 1.

if I2S_1

config I2S_1_NAME
	string "I2S port 1 device name"
	default "I2S_1"

endif # I2S_1

config	I2S_2
	bool "I2S port 2"
	default n
	help
	  Enable I2S controller port 2.

if I2S_2

config I2S_2_NAME
	string "I2S port 2 device name"
	default "I2S_2"

endif # I2S_2

config	I2S_3
	bool "I2S port 3"
	default n
	help
	  Enable I2S controller port 3.

if I2S_3

config I2S_3_NAME
	string "I2S port 3 device name"
	default "I2S_3"

endif # I2S_3

config	I2S_4
	bool "I2S port 4"
	default n
	help
	  Enable I2S controller port 4.

if I2S_4

config I2S_4_NAME
	string "I2S port 4 device name"
	default "I2S_4"

endif # I2S_4

config	I2S_5
	bool "I2S port 5"
	default n
	help
	  Enable I2S controller port 5.

if I2S_5

config I2S_5_NAME
	string "I2S port 5 device name"
	default "I2S_5"

endif # I2S_5

comment "Device Drivers"

gsource "drivers/i2s/Kconfig.*"

endif # I2S
```

## drivers/i2s/Kconfig.stm32
```kconfig
# Kconfig - STM32 I2S driver configuration options
#
# Copyright (c) 2018 STMicroelectronics
#
# SPDX-License-Identifier: Apache-2.0
#

menuconfig I2S_STM32
	bool "STM32 MCU I2S controller driver"
	depends on I2S && SOC_SERIES_STM32F4X
	select DMA
	default n
	help
	  Enable I2S support on the STM32 family of processors.

if I2S_STM32

config I2S_STM32_RX_BLOCK_COUNT
	int "RX queue length"
	default 4

config I2S_STM32_TX_BLOCK_COUNT
	int "TX queue length"
	default 4


endif # I2S_STM32
```

## drivers/sensor/iis2dlpc/Kconfig
```kconfig
# ST Microelectronics IIS2DLPC 3-axis accelerometer driver

# Copyright (c) 2020 STMicroelectronics
# SPDX-License-Identifier: Apache-2.0

menuconfig IIS2DLPC
	bool "IIS2DLPC I2C/SPI accelerometer sensor driver"
	depends on I2C || SPI
	select HAS_STMEMSC
	select USE_STDC_IIS2DLPC
	help
	  Enable driver for IIS2DLPC accelerometer sensor driver

if IIS2DLPC

choice IIS2DLPC_TRIGGER_MODE
	prompt "Trigger mode"
	help
	  Specify the type of triggering to be used by the driver.

config IIS2DLPC_TRIGGER_NONE
	bool "No trigger"

config IIS2DLPC_TRIGGER_GLOBAL_THREAD
	bool "Use global thread"
	depends on GPIO
	select IIS2DLPC_TRIGGER

config IIS2DLPC_TRIGGER_OWN_THREAD
	bool "Use own thread"
	depends on GPIO
	select IIS2DLPC_TRIGGER

endchoice

config IIS2DLPC_TRIGGER
	bool

if IIS2DLPC_TRIGGER

config IIS2DLPC_THREAD_PRIORITY
	int "Thread priority"
	depends on IIS2DLPC_TRIGGER_OWN_THREAD
	default 10
	help
	  Priority of thread used by the driver to handle interrupts.

config IIS2DLPC_THREAD_STACK_SIZE
	int "Thread stack size"
	depends on IIS2DLPC_TRIGGER_OWN_THREAD
	default 1024
	help
	  Stack size of thread used by the driver to handle interrupts.

choice
	prompt "Sensor INT pin number"
	default IIS2DLPC_INT_PIN_1
	help
	  The number of IIS2DLPC int pin used to generate interrupt to cpu.
	  Supported values are int1 or int2

config IIS2DLPC_INT_PIN_1
	bool "int1"

config IIS2DLPC_INT_PIN_2
	bool "int2"
endchoice

config IIS2DLPC_PULSE
	bool "Pulse detection"
	help
	  Enable pulse (single/double tap) detection

endif # IIS2DLPC_TRIGGER

endif # IIS2DLPC
```

## drivers/sensor/lis2du12/Kconfig
```kconfig
# ST Microelectronics LIS2DU12 3-axis accelerometer sensor driver

# Copyright (c) 2023 STMicroelectronics
# SPDX-License-Identifier: Apache-2.0

menuconfig LIS2DU12
	bool "LIS2DU12 I2C/SPI smartxl Chip"
	default y
	depends on DT_HAS_ST_LIS2DU12_ENABLED
	select I2C if $(dt_compat_on_bus,$(DT_COMPAT_ST_LIS2DU12),i2c)
	select SPI if $(dt_compat_on_bus,$(DT_COMPAT_ST_LIS2DU12),spi)
	select HAS_STMEMSC
	select USE_STDC_LIS2DU12
	help
	  Enable driver for LIS2DU12 smartxl
	  sensor.

if LIS2DU12

choice LIS2DU12_TRIGGER_MODE
	prompt "Trigger mode"
	help
	  Specify the type of triggering to be used by the driver.

config LIS2DU12_TRIGGER_NONE
	bool "No trigger"

config LIS2DU12_TRIGGER_GLOBAL_THREAD
	bool "Use global thread"
	depends on GPIO
	select LIS2DU12_TRIGGER

config LIS2DU12_TRIGGER_OWN_THREAD
	bool "Use own thread"
	depends on GPIO
	select LIS2DU12_TRIGGER

endchoice

config LIS2DU12_TRIGGER
	bool

if LIS2DU12_TRIGGER

config LIS2DU12_THREAD_PRIORITY
	int "Thread priority"
	depends on LIS2DU12_TRIGGER_OWN_THREAD
	default 10
	help
	  Priority of thread used by the driver to handle interrupts.

config LIS2DU12_THREAD_STACK_SIZE
	int "Thread stack size"
	depends on LIS2DU12_TRIGGER_OWN_THREAD
	default 1024
	help
	  Stack size of thread used by the driver to handle interrupts.

endif # LIS2DU12_TRIGGER

config LIS2DU12_ENABLE_TEMP
	bool "Temperature"
	help
	  Enable/disable temperature

endif # LIS2DU12
```

## dts/bindings/audio/st,st-dmic-i2s.yaml
```yaml
#
# Copyright (c) 2018 STMicroelectronics
#
# SPDX-License-Identifier: Apache-2.0
#
---
title: ST Microelectronics ST_DMIC_I2S pdm microphone
version: 0.1

description: >
    This binding gives a base representation of ST_DMIC_I2S pdm microphone

inherits:
    !include i2s-device.yaml

properties:
    compatible:
      constraint: "st,st-dmic-i2s"
    label:
      type: string
      category: required
      description: Human readable string describing the device (used by Zephyr for API name)
      generation: define

...
```

## dts/bindings/sensor/st,iis2dlpc-common.yaml
```yaml
# Copyright (c) 2018 STMicroelectronics
# SPDX-License-Identifier: Apache-2.0

properties:
    drdy-gpios:
      type: phandle-array
      required: false
      description: DRDY pin

        This pin defaults to active high when produced by the sensor.
        The property value should ensure the flags properly describe
        the signal that is presented to the driver.

    range:
      type: int
      required: false
      default: 2
      description: Range in g
      enum:
        - 16 # 16g (1.952 mg/LSB)
        -  8 #  8g (0.976 mg/LSB)
        -  4 #  4g (0.488 mg/LSB)
        -  2 #  2g (0.244 mg/LSB)

    power-mode:
      type: int
      required: false
      default: 0
      description: Specify the sensor power mode
      enum:
        - 0 # Low Power M1
        - 1 # Low Power M2
        - 2 # Low Power M3
        - 3 # Low Power M4
        - 4 # High Performance

    pulse-mode:
      type: int
      required: false
      default: 0
      description: Pulse mode
      enum:
        - 0 # Only Single
        - 1 # Single adn Double

    pulse-thsx:
      type: int
      required: false
      default: 0x0E
      description: Pulse X-axis threshold
        (values range from 0x00 to 0x1F)
        Threshold to start the pulse-event detection procedure on the X-axis.
        Threshold values for each axis are unsigned 5-bit corresponding
        to an 2g acceleration full-scale range.

    pulse-thsy:
      type: int
      required: false
      default: 0x0E
      description: Pulse Y-axis threshold
        (values range from 0x00 to 0x1F)
        Threshold to start the pulse-event detection procedure on the Y-axis.
        Threshold values for each axis are unsigned 5-bit corresponding
        to an 2g acceleration full-scale range.

    pulse-thsz:
      type: int
      required: false
      default: 0x0E
      description: Pulse Z-axis threshold
        (values range from 0x00 to 0x1F)
        Threshold to start the pulse-event detection procedure on the Z-axis.
        Threshold values for each axis are unsigned 5-bit corresponding
        to an 2g acceleration full-scale range.

    pulse-x-enable:
      type: int
      required: false
      default: 1
      description: Enable X axis for pulse

    pulse-y-enable:
      type: int
      required: false
      default: 1
      description: Enable Y axis for pulse

    pulse-z-enable:
      type: int
      required: false
      default: 1
      description: Enable Z axis for pulse

    pulse-shock:
      type: int
      required: false
      default: 0x00
      description: Pulse shock value
        (values range from 0x0 to 0x3)
        This register represents the maximum time of an over-threshold signal
        detection to be recognized as a tap event. Where 0 equals 4*1/ODR and
        1LSB = 8*1/ODR.

    pulse-ltcy:
      type: int
      required: false
      default: 0x05
      description: Pulse latency
        (values range from 0x0 to 0xF)
        When double-tap recognition is enabled, this register expresses the
        maximum time between two successive detected taps to determine a
        double-tap event. Where 0 equals 16*1/ODR and 1LSB = 32*1/ODR.

    pulse-quiet:
      type: int
      required: false
      default: 0x00
      description: Expected quiet time after a tap detection
        (values range from 0x0 to 0x3)
        This register represents the time after the first detected tap in which
        there must not be any overthreshold event. Where 0 equals 2*1/ODR
        and 1LSB = 4*1/ODR.
```

## dts/bindings/sensor/st,iis3dhhc-spi.yaml
```yaml
#
# Copyright (c) 2019 STMicroelectronics
#
# SPDX-License-Identifier: Apache-2.0
#

title: STMicroelectronics MEMS sensors IIS3DHHC SPI

description: >
    This binding gives a base representation of IIS3DHHC 3-axis accelerometer
    accessed through SPI bus

inherits:
    !include spi-device.yaml

properties:
    compatible:
        constraint: "st,iis3dhhc"

    irq-gpios:
      type: compound
      category: required
```

## dts/bindings/sensor/st,lis2mdl-spi.yaml
```yaml
#
# Copyright (c) 2019 STMicroelectronics
#
# SPDX-License-Identifier: Apache-2.0
#

title: STMicroelectronics MEMS sensors LIS2MDL SPI

description: >
    This binding gives a base representation of LIS2MDL magnetometer
    accessed through SPI bus

inherits:
    !include spi-device.yaml

properties:
    compatible:
        constraint: "st,lis2mdl-magn"

    irq-gpios:
      type: compound
      category: required
```

## dts/bindings/spi/st,stm32-spi.yaml
```yaml
# Copyright (c) 2018, I-SENSE group of ICCS
# SPDX-License-Identifier: Apache-2.0

description: STM32 SPI controller

compatible: "st,stm32-spi"

include: [spi-controller.yaml, dma.yaml]

properties:
    reg:
      required: true

    interrupts:
      required: true

#  refer to st,stm32-dma.yaml for definition of the client part
```
